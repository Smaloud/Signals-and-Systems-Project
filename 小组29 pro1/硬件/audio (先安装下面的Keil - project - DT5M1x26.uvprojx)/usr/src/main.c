#include "DT5M1x26.h"
#include "play_audio.h"
#include <stdio.h>
#include <stdlib.h>
#include <math.h>

#define N 15748 //wav数据长度
int16_t const code_bjkjg_pcm[]={
5,5,6,7,7,6,7,7,7,6,5,5,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-399
};//wav的数据
uint16_t length = 0;
uint16_t rd = 0;
uint8_t play_times = 0;
uint32_t audio_buff;
uint8_t i=0;

void Sound_Int_Usr_Handler(void)
{
    if(Sound_GetInt()){
      Sound_ClearInt();
			audio_buff=abs(code_bjkjg_pcm[rd]);
			audio_buff=audio_buff<<16;
 			rd=rd+1;
	}
  if (rd >= N){
			rd = 0;
			i= 0;
			play_times++;	
  }
    if(Sound_GetFifoPointer()) Sound_Fill_FIFO1(audio_buff);//按照次序将wav的数据以此输入
    else Sound_Fill_FIFO0(audio_buff);
				
}


void Audio_GPIO_Init(void)
{
	GPIO_InitTypeDef GPIO_Init = { 0 };
	GPIO_Init.GPIO_Pin = GPIO_PIN_15;
	GPIO_Init.GPIO_Dir = GPIO_DIR_OUT;
	GPIO_Init.GPIO_Mode = GPIO_MODE_SF;
	GPIO_StructInit(GPIOA, &GPIO_Init);
	GPIO_Pins_Set(GPIOA,GPIO_PIN_15);
	
	GPIO_Init.GPIO_Pin = GPIO_PIN_14;
	GPIO_Init.GPIO_Dir = GPIO_DIR_OUT;
	GPIO_Init.GPIO_Mode = GPIO_MODE_GP;
	GPIO_StructInit(GPIOA, &GPIO_Init);
	GPIO_Pins_Set(GPIOA,GPIO_PIN_14);
}

void PlayAudio_Init(void)
{
    Sound_InitStruct Sound_Init = {0};

    RCC_SoundClk_Int(1);
    Sound_Init.unsigne_en   = 0;
    Sound_Init.sound_format = SOUND_FORMAT_PCM;//wav音频使用PCM采样
    Sound_Init.sample_rate  = SOUND_SAMPLE_RATE_16K;//wav音频的采样率，对应fs 
		//对应SOUND_SAMPLE_RATE_8K。SOUND_SAMPLE_RATE_16K，SOUND_SAMPLE_RATE_44.1K
    Sound_Init.pcm_frist_value = 0;
    Sound_StructInit(&Sound_Init);                  

    Sound_Fill_FIFO0(0);
    Sound_Fill_FIFO1(0);
    Sound_EnableInt();
}

void playAudio_Stop(void)
{
	Sound_Fill_FIFO0(0);
	Sound_Fill_FIFO1(0);
	Sound_DisableInt();
}
int main(void)
{	
	Audio_GPIO_Init();
	PlayAudio_Init();
  while(1){
		if (play_times >= 1)//设置音频循环的播放次数
			{
      play_times = 0;
      playAudio_Stop();    
		}
		
	}
}